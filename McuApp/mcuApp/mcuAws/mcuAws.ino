#include <ESP8266WiFi.h>
#include <PubSubClient.h> //https://pubsubclient.knolleary.net/

unsigned char ca_der[] = {
  0x30, 0x82, 0x03, 0x41, 0x30, 0x82, 0x02, 0x29, 0xa0, 0x03, 0x02, 0x01,
  0x02, 0x02, 0x13, 0x06, 0x6c, 0x9f, 0xcf, 0x99, 0xbf, 0x8c, 0x0a, 0x39,
  0xe2, 0xf0, 0x78, 0x8a, 0x43, 0xe6, 0x96, 0x36, 0x5b, 0xca, 0x30, 0x0d,
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  0x59, 0x33, 0xf8, 0xeb, 0xc4, 0x90, 0xbe, 0xf1, 0xb9
};
unsigned int ca_der_len = 837;

unsigned char private_der[] = {
  0x30, 0x82, 0x04, 0xa0, 0x02, 0x01, 0x00, 0x02, 0x82, 0x01, 0x01, 0x00,
  0xd9, 0x3c, 0x37, 0xbd, 0xc7, 0xba, 0xf5, 0x28, 0xc5, 0xac, 0x65, 0xc6,
  0x89, 0xba, 0x10, 0x0b, 0xa0, 0x04, 0xd1, 0x96, 0x7c, 0xc6, 0x56, 0xa2,
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  0x9c, 0x15, 0x30, 0xf8, 0x33, 0xc1, 0xd9, 0xca, 0xbd, 0xb6, 0xdf, 0xb9
};
unsigned int private_der_len = 1188;

unsigned char cert_der[] = {
  0x30, 0x82, 0x03, 0x59, 0x30, 0x82, 0x02, 0x41, 0xa0, 0x03, 0x02, 0x01,
  0x02, 0x02, 0x14, 0x78, 0xf0, 0x19, 0xf6, 0x78, 0x35, 0xa5, 0xc5, 0xf3,
  0xc2, 0x6d, 0x90, 0x45, 0xc0, 0x8f, 0x11, 0xdd, 0x06, 0xdf, 0xc4, 0x30,
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  0x80, 0x8c, 0xd2, 0x7e, 0xb1, 0xdd, 0x29, 0xfe, 0x7b
};
unsigned int cert_der_len = 861;

const char* ssid = "LABO14";
const char* password = "catolica14";
const char* mqtt_server = "a3qi15dj1wl62m-ats.iot.us-east-2.amazonaws.com";

WiFiClientSecure wifiClient;
PubSubClient mqttClient(wifiClient);
long lastMsg = 0;
char msg[50];
int value = 0;

void callback(char* topic, byte* payload, unsigned int length) {
  Serial.print("Message arrived [");
  Serial.print(topic);
  Serial.print("] ");
  for (int i = 0; i < length; i++)
    Serial.print((char)payload[i]);

  Serial.println();
}

void reconnect() {
  // Loop until we're reconnected
  while (!mqttClient.connected()) {
    Serial.print("Attempting MQTT connection...");
    // Create a random client ID
    String clientId = "ESP8266Client-";
    clientId += String(random(0xffff), HEX);
    // Attempt to connect
    if (mqttClient.connect(clientId.c_str())) {
      Serial.println("connected");
      mqttClient.subscribe("inTopic");
    } else {
      Serial.print("failed, rc=");
      Serial.print(mqttClient.state());
      Serial.println(" try again in 5 seconds");
      // Wait 5 seconds before retrying
      delay(5000);
    }
  }
}

void setup_wifi() {
  delay(10);
  // We start by connecting to a WiFi network
  Serial.println();
  Serial.print("Connecting to ");
  Serial.println(ssid);

  WiFi.begin(ssid, password);

  while (WiFi.status() != WL_CONNECTED) {
    delay(500);
    Serial.print(".");
  }

  randomSeed(micros());

  Serial.println("");
  Serial.println("WiFi connected");
  Serial.println("IP address: ");
  Serial.println(WiFi.localIP());
}

void setup_wifiClient() {
  wifiClient.setCertificate(cert_der, cert_der_len);
  wifiClient.setPrivateKey(private_der, private_der_len);
  wifiClient.setCACert(ca_der, ca_der_len);
}

void setup_mqttClient() {
  mqttClient.setServer(mqtt_server, 8883);
  mqttClient.setCallback(callback);  
}

void setup() {
  Serial.begin (115200);
  
  setup_wifi();

  setup_wifiClient();

  setup_mqttClient();
}

void loop() {
  
  if (!mqttClient.connected()) {
    reconnect();
  }
  mqttClient.loop();

  long now = millis();
  if (now - lastMsg > 10000) {
    lastMsg = now;
    ++value;
    snprintf (msg, 75, "hello world #%ld", value);
    Serial.print("Publish message: ");
    Serial.println(msg);
    mqttClient.publish("outTopic", msg);
  }
}
